## drivers/huawei/device/Kconfig
```kconfig
menu "huawei linux device driver support package"

source "drivers/huawei/device/touchscreen/Kconfig"

source "drivers/huawei/device/accelerometer/Kconfig"

source "drivers/huawei/device/compass/Kconfig"

source "drivers/huawei/device/light/Kconfig"

source "drivers/huawei/device/gyroscope/Kconfig"

endmenu
```

## drivers/huawei/device/compass/Kconfig
```kconfig
# compass driver configuration
#
menuconfig INPUT_COMPASS
	bool "Compass"
	default y 
	help
	  Say Y here, and a list of supported COMPASSs will be displayed.
	  This option doesn't affect the kernel.

	 

if INPUT_COMPASS

config HUAWEI_FEATURE_SENSORS_AK8975
	tristate "AK8975"
	default y 
	depends on I2C
	help
	  If you say yes here you get support for Asahi Kasei's 
	  orientation sensor AK8975.

endif
```

## drivers/huawei/device/light/Kconfig
```kconfig
# light sensor driver configuration
#
menuconfig INPUT_LIGHT_SENSOR
	bool "light sensor"
	default y 
	help
	  Say Y here, and a list of supported light sensors will be displayed.
	  This option doesn't affect the kernel.

	 

if INPUT_LIGHT_SENSOR
config  HUAWEI_FEATURE_PROXIMITY_LITEON_LTR_558
        default y
        tristate "LITEON LTR-558 Proximity"
        help
         Say Y here if you have a llteon ltr-558 proximity.
          If unsure, say N.
          To compile this driver as a module, choose M here: the
          module will be called ltr-558.
config HUAWEI_FEATURE_PROXIMITY_EVERLIGHT_TMD2771
	tristate "tmd2771"
	default n
	help
	  If you say yes here you get support for taos light sensor tmd2771.
config HUAWEI_FEATURE_PROXIMITY_APDS990X
	tristate "apds990x"
	default y
	help
	  If you say yes here you get support for light sensor apds990x.

endif
```

## drivers/huawei/device/touchscreen/Kconfig
```kconfig
#
# Touchscreen driver configuration
#
menuconfig INPUT_TOUCHSCREEN
	bool "Touchscreens"
	help
	  Say Y here, and a list of supported touchscreens will be displayed.
	  This option doesn't affect the kernel.

	  If unsure, say Y.

if INPUT_TOUCHSCREEN

config TOUCHSCREEN_MXT224E_ATMEL
        default y
	bool "Atmel mXT224E touchscreens"
	depends on I2C
	help
          Say Y here to enable support Atmel mXT224E

config TOUCHSCREEN_RMI4_SYNAPTICS
        default y
	bool "Synaptics RMI4 1564 touchscreens"
	depends on I2C
	help
          Say Y here to enable support Synaptics RMI4 1564

config  SYNAPTICS_UPDATE_RMI_TS_FIRMWARE
	default n
	depends on TOUCHSCREEN_RMI4_SYNAPTICS
	bool "SYNAPTICS Touchscreen firmware update"
	help
	  Say Y here if you have a synaptics touchscren and want to 
	  update the firmware.
	  If unsure, say N.
endif
```

## drivers/huawei/hsad/Kconfig
```kconfig
#
# Board ID configuration
#

menu "Board ID Configuration Support"

config BOARD_ID
	bool "Board ID Support"
	default y
	help
		if you config this,driver can config themself according the board id.

endmenu
```

## drivers/i2c/chips/Kconfig
```kconfig
#
# Miscellaneous I2C chip drivers configuration
#
# *** DEPRECATED! Do not add new entries! See Makefile ***
#

menu "Miscellaneous I2C Chip support"
	
config ES305
	tristate "Audience es305 device"
	default y
	depends on EXPERIMENTAL
	help
	  If you say yes here you get support for Audience es305.

	  This driver can also be built as a module.  If so, the module
	  will be called Audience_es305.

endmenu
```

## drivers/staging/thermal_framework/sensor/Kconfig
```kconfig
#
# Thermal Temp sensor configuration
#
config OMAP4_DIE_TEMP_SENSOR
	bool "OMAP On-Die temp sensor support"
	depends on THERMAL_FRAMEWORK && OMAP_THERMAL && OMAP_TEMP_SENSOR
	help
	  Enabling this config will give support for the on-die
	  temp sensor for the OMAP platform.

config OMAP4_PCB_SENSOR
	bool "OMAP PCB temp sensor support"
	depends on THERMAL_FRAMEWORK && OMAP_THERMAL && OMAP_TEMP_SENSOR
	help
	  Enabling this config will give support for the pcb
	  temp sensor for the OMAP platform.
config CASE_TEMP_SENSOR
	bool "Case temp sensor support"
	default y
	depends on THERMAL_FRAMEWORK && OMAP_THERMAL
	help
	  Enabling this config will give support for the case
	  temp sensor for the OMAP platform.
```

## drivers/switch/Kconfig
```kconfig
menuconfig SWITCH
    tristate "Switch class support"
    help
      Say Y here to enable switch class support. This allows
      monitoring switches by userspace via sysfs and uevent.

if SWITCH

config SWITCH_GPIO
    tristate "GPIO Swith support"
    depends on GENERIC_GPIO
    help
      Say Y here to enable GPIO based switch support.

config SWITCH_USB
        tristate "USB Swith support"
        depends on GENERIC_GPIO
        help
          Say Y here to enable USB switch support.

config SWITCH_USB_TTY_NAME
        string "send AT cmd by tty"
        depends on SWITCH_USB
        default "/dev/xmd-tty5"
        help
            Set the correct tty, otherwise the AT cmd can't not sent.
endif # SWITCH
```
